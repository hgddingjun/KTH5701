## kth5701_drv_app/drv/kernel-4.19/drivers/misc/mediatek/magencoder/Kconfig
```kconfig
config DW_MAGNETICENCODER_KTH5701
	bool "Magnetic encoder kth5701 IC"
	default n
	help
	  Magnetic Encoder
	  vendor type kth5701
```
